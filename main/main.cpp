// Ethoric-10M on the ESP32-S3 (N16R8): weights live in the "model" flash partition.
//
// Boot sequence:
//   1. map the partition and verify its CRC32;
//   2. copy the weights into PSRAM (faster than flash) as far as they fit;
//   3. benchmark the float kernels and keep the fastest;
//   4. enable the SIMD (PIE) integer kernels, but only if they match the C reference bit for bit;
//   5. decide whether the second core pays off;
//   6. generate text and stream it to the console.
//
// Tested on an ESP32-S3-WROOM-1 N16R8 with ESP-IDF v6.1.
#include <cstdio>
#include <cstdlib>
#include <string>

#include "esp_attr.h"
#include "esp_heap_caps.h"
#include "esp_log.h"
#include "esp_partition.h"
#include "esp_random.h"
#include "driver/uart.h"
#include "esp_timer.h"
#include "freertos/FreeRTOS.h"
#include "freertos/semphr.h"
#include "freertos/task.h"

// ---------------------------------------------------------------------------------------------------------------
// Configuration
// ---------------------------------------------------------------------------------------------------------------
#define USE_PIE 1             // 1 = use the ESP32-S3 SIMD (PIE) kernels. Set to 0 if the inline assembly does not build.
#define MAX_CTX 160           // Maximum context (prompt + N_NEW). fp32 KV cache: ~0.95 MB at 160, ~1.5 MB at 256.
                              // Every MB of KV cache saved leaves 1 MB more of weights in PSRAM (flash is ~3x slower).
#define N_NEW 128             // Tokens to generate.
#define VERIFY_CRC 1          // Verify the model CRC32 at boot (reads the whole partition, ~0.5 s).
#define SAMPLE_TEMP 0.8f      // Sampling temperature (0 = greedy; greedy decoding falls into repetition loops).
#define SAMPLE_TOP_K 20       // Top-k cut-off.
#define SAMPLE_REP 1.2f       // Repetition penalty (1.0 = off).
#define USE_PSRAM_COPY 1      // Copy the weights into PSRAM (reading flash is slower).
#define PSRAM_RESERVE_KB 128  // PSRAM kept free for the heap and task stacks.
#define AUTOTUNE 1            // Benchmark kernels at boot and keep the fastest.
#define USE_DUAL_CORE 1       // Allow core 1 to help (only kept if the boot measurement shows a gain).
#define FORCE_KERNEL nullptr  // e.g. "r4" to pin the float kernel (ref, u4, r4, r8) and skip the benchmark.
#define PRINT_IDS 0           // 1 = also print "TOKEN n" lines (see tools/tokenize_prompt.py --decode-log).
#define PER_TOKEN_LOG 0       // 1 = log every token (slows the output; for debugging).
#define CHAT_MODE 1           // 1 = interactive: wait for prompts on the serial port (tools/chat.py); 0 = generate once from PROMPT at boot.
#define USE_HTTP_SERVER 1     // 1 = start WiFi and the HTTP server (POST /completion) (credentials from .env).
#define CHAT_UART UART_NUM_0  // UART carrying the console (the USB-serial bridge on most dev boards).
#define CHAT_LINE_MAX 2048    // Longest accepted request line, in characters.
#define YIELD_MS 500          // Period at which the main task yields core 0 so IDLE0 can feed the watchdog.

#if USE_PIE
#define ETHORIC_PIE 1
#endif
#include "dual_core.hpp"
#include "engine.hpp"
#include "ethoric.hpp"
#include "sampler.hpp"

#include "prompt.inc"  // static const int PROMPT[] = {...};  generated by tools/tokenize_prompt.py

static const char* TAG = "ethoric";

// Guard: if the SIMD self-check crashes the chip (exception -> reset), the next boot skips SIMD instead of looping.
static RTC_NOINIT_ATTR uint32_t g_pie_trying;
static const uint32_t PIE_MAGIC = 0x50494531u;

static const int kPromptLen = (int)(sizeof(PROMPT) / sizeof(PROMPT[0]));

// ---------------------------------------------------------------------------------------------------------------
// Helpers
// ---------------------------------------------------------------------------------------------------------------
static int64_t now_us() { return esp_timer_get_time(); }

static void* psram_alloc(size_t n) { return heap_caps_aligned_alloc(64, n, MALLOC_CAP_SPIRAM | MALLOC_CAP_8BIT); }

static void log_mem(const char* tag) {
  ESP_LOGI(TAG, "[%s] free PSRAM %u KB | free internal RAM %u KB", tag,
           (unsigned)(heap_caps_get_free_size(MALLOC_CAP_SPIRAM) / 1024),
           (unsigned)(heap_caps_get_free_size(MALLOC_CAP_INTERNAL) / 1024));
}

// Maps the "model" partition (data, subtype 0x40) into the address space; returns its pointer and size.
static const uint8_t* map_model(size_t* size) {
  const esp_partition_t* part =
      esp_partition_find_first(ESP_PARTITION_TYPE_DATA, (esp_partition_subtype_t)0x40, "model");
  if (!part) {
    ESP_LOGE(TAG, "partition 'model' not found: check partitions.csv and delete any stale sdkconfig");
    return nullptr;
  }
  const void* ptr = nullptr;
  esp_partition_mmap_handle_t handle;
  esp_err_t e = esp_partition_mmap(part, 0, part->size, ESP_PARTITION_MMAP_DATA, &ptr, &handle);
  if (e != ESP_OK) {
    ESP_LOGE(TAG, "mmap of partition 'model' (%u KB) failed: %s", (unsigned)(part->size / 1024), esp_err_to_name(e));
    return nullptr;
  }
  *size = part->size;
  return static_cast<const uint8_t*>(ptr);
}

// Mean time per token over `n` tokens starting from an empty state; leaves the runner reset.
// The yield between tokens is outside the timed region.
static double time_tokens(ethoric::Runner& run, int n = 3) {
  run.reset();
  int64_t total = 0;
  for (int i = 0; i < n; i++) {
    const int64_t t0 = now_us();
    run.step(PROMPT[i % kPromptLen]);
    total += now_us() - t0;
    vTaskDelay(1);  // let IDLE0 feed the watchdog
  }
  run.reset();
  return total / 1e3 / n;
}

// ---------------------------------------------------------------------------------------------------------------
// Boot stages
// ---------------------------------------------------------------------------------------------------------------

// Rows of the benchmark matrix: the attention query projection, which is always int8.
static int bench_rows(const ethoric::Model& model) { return model.cfg.n_head * model.cfg.hd; }

// Times every float kernel on the layer-0 query projection (whatever memory it currently lives in).
static void bench_kernels(const ethoric::Model& model, const char* label, bool pick_best) {
  const auto& L = model.layers[0];
  const int rows = bench_rows(model);
  static float xb[256], yb[1024];
  for (int i = 0; i < model.cfg.d && i < 256; i++) xb[i] = 0.5f;
  ESP_LOGI(TAG, "float kernels on %s (matrix %dx%d, us):", label, rows, model.cfg.d);
  double best = 1e30;
  const ethoric::KernelInfo* best_kernel = nullptr;
  for (int k = 0; k < ethoric::kNumKernels; k++) {
    const double us = ethoric::bench_kernel(ethoric::kKernels[k].fn, L.q.q, L.q.s, xb, yb, rows, model.cfg.d, 5, now_us);
    ESP_LOGI(TAG, "  %-3s %8.0f", ethoric::kKernels[k].name, us);
    if (us < best) { best = us; best_kernel = &ethoric::kKernels[k]; }
  }
  if (pick_best && best_kernel) {
    ethoric::g_mv = best_kernel->fn;
    ESP_LOGI(TAG, "selected float kernel: %s", best_kernel->name);
  }
}

// Copies the weights into PSRAM as far as the budget allows.
static void relocate_weights(ethoric::Model& model) {
  const size_t free_ps = heap_caps_get_free_size(MALLOC_CAP_SPIRAM);
  const size_t reserve = size_t(PSRAM_RESERVE_KB) * 1024;
  const size_t budget = free_ps > reserve ? free_ps - reserve : 0;
  const int64_t t0 = now_us();
  const size_t used = model.relocate(psram_alloc, budget);
  ESP_LOGI(TAG, "weights copied to PSRAM: %.2f MiB of %.2f MiB (%.2f s)", used / 1048576.0,
           model.total_bytes() / 1048576.0, (now_us() - t0) / 1e6);
}

// Enables int8 activations and the SIMD kernels. Each SIMD kernel is switched on only if it matches the C
// reference bit for bit. A model with int4 MLP layers requires int8 activations (the C fallback is correct but slow).
static void select_arithmetic(const ethoric::Model& model, ethoric::Runner& run) {
  const bool int4 = model.has_int4();
  bool simd8 = false, simd4 = false;
#if USE_PIE
  if (g_pie_trying == PIE_MAGIC) {
    ESP_LOGW(TAG, "the SIMD self-check crashed the chip on the previous boot: SIMD disabled (power-cycle to retry)");
    g_pie_trying = 0;
  } else {
    g_pie_trying = PIE_MAGIC;  // if the chip hangs before this is cleared, the next boot skips SIMD
    const auto& L0 = model.layers[0];
    bool ok8 = ethoric::a8_selfcheck(ethoric::mv_a8_pie, L0.q, 64) && ethoric::a8_selfcheck(ethoric::mv_a8_pie, L0.o, 64) &&
               ethoric::a8_selfcheck(ethoric::mv_a8_pie, model.embed, 256);
    bool ok4 = true, any4 = false;
    for (int l = 0; l < model.cfg.n_layer; l++) {
      const auto& L = model.layers[l];
      const ethoric::Mat* ms[3] = {&L.mlp_gate, &L.mlp_up, &L.mlp_down};
      for (int m = 0; m < 3; m++) {
        if (ms[m]->bits == 4) {
          any4 = true;
          ok4 = ok4 && ethoric::a4_selfcheck(ethoric::mv_a4_pie, *ms[m], 64);
        } else {
          ok8 = ok8 && ethoric::a8_selfcheck(ethoric::mv_a8_pie, *ms[m], 64);  // mlp_down has ld = 736 (721 + padding)
        }
      }
      if (l >= 1 && any4 && ok4 && ok8) break;  // sampling the first layers is enough
    }
    g_pie_trying = 0;
    ESP_LOGI(TAG, "SIMD vs C (bit-exact): int8 %s | int4 %s", ok8 ? "ok" : "MISMATCH",
             !any4 ? "n/a" : (ok4 ? "ok" : "MISMATCH"));
    simd8 = ok8;
    simd4 = ok4 && any4;
  }
#endif
  if (simd8) ethoric::g_a8 = ethoric::mv_a8_pie_sel();
  if (int4) {
    ethoric::g_aq_group = 32;
    if (simd4) ethoric::g_a4 = ethoric::mv_a4_pie_sel();
    ESP_LOGI(TAG, "int4 MLP + int8 activations: %s/%s kernels", simd8 ? "SIMD" : "C", simd4 ? "SIMD" : "C");
    if (!simd8 || !simd4) ESP_LOGW(TAG, "without SIMD an int4 model is SLOW: re-export with --mlp-bits 8 or report the log");
  } else if (simd8) {
    const double t_float = time_tokens(run);
    ethoric::g_aq_group = 32;
    const double t_simd = time_tokens(run);
    ESP_LOGI(TAG, "float activations: %.0f ms/token | int8 + SIMD: %.0f ms/token", t_float, t_simd);
    if (t_simd >= t_float * 0.95) {
      ethoric::g_aq_group = 0;
      ESP_LOGI(TAG, "SIMD does not pay off: keeping float activations");
    } else {
      ESP_LOGI(TAG, "using int8 activations + SIMD");
    }
  }
}

// Starts the helper task on core 1 and keeps it only if it makes a token measurably faster.
static void select_cores(ethoric::Runner& run) {
#if USE_DUAL_CORE
  static DualCore dual;
  if (!dual.start()) {
    ESP_LOGW(TAG, "could not create the core-1 task: using one core");
    return;
  }
  const double t1 = time_tokens(run);
  run.set_parallel(dual.parallel());
  const double t2 = time_tokens(run);
  ESP_LOGI(TAG, "1 core: %.0f ms/token | 2 cores: %.0f ms/token", t1, t2);
  if (t2 >= t1 * 0.95) {
    run.set_parallel(nullptr);
    ESP_LOGI(TAG, "2 cores do not pay off: using 1");
  } else {
    ESP_LOGI(TAG, "using 2 cores");
  }
#else
  (void)run;
#endif
}

// ---------------------------------------------------------------------------------------------------------------
// Generation engine (shared by the serial console and the HTTP server)
// ---------------------------------------------------------------------------------------------------------------

static ethoric::Model* g_model = nullptr;
static ethoric::Runner* g_run = nullptr;
static SemaphoreHandle_t g_busy = nullptr;  // held while a generation runs: the model state is single-user

typedef void (*EmitFn)(void* ctx, const uint8_t* bytes, int len);

static void console_emit(void*, const uint8_t* b, int n) {
  fwrite(b, 1, n, stdout);
  fflush(stdout);
}

static void string_emit(void* ctx, const uint8_t* b, int n) { static_cast<std::string*>(ctx)->append((const char*)b, n); }

// Passes the text of token `id` to `emit` (or "TOKEN n" when the model file has no embedded vocabulary).
static void emit_token(const ethoric::Model& model, int id, EmitFn emit, void* ctx) {
  int len = 0;
  const uint8_t* b = model.token_bytes(id, &len);
  if (b) {
    if (len > 0) emit(ctx, b, len);
#if PRINT_IDS
    char t[24];
    emit(ctx, (const uint8_t*)t, snprintf(t, sizeof(t), "\nTOKEN %d\n", id));
#endif
  } else {
    char t[24];
    emit(ctx, (const uint8_t*)t, snprintf(t, sizeof(t), "TOKEN %d\n", id));
  }
}

// Feeds the prompt, then samples up to gp.max_new tokens. Fills *st. Returns false if the prompt does not fit.
static bool generate(const int* prompt, int prompt_len, const GenParams& gp, EmitFn emit, void* ctx, GenStats* st) {
  const ethoric::Model& model = *g_model;
  ethoric::Runner& run = *g_run;
  const int max_new = gp.max_new >= 0 ? gp.max_new : N_NEW;
  run.reset();
  ethoric::Sampler sampler(model.cfg.vocab, 64, gp.seed ? gp.seed : esp_random());
  sampler.temp = gp.temp >= 0.f ? gp.temp : SAMPLE_TEMP;
  sampler.top_k = gp.top_k >= 0 ? gp.top_k : SAMPLE_TOP_K;
  sampler.rep_penalty = gp.rep > 0.f ? gp.rep : SAMPLE_REP;

  static int hist[MAX_CTX];
  int n_hist = 0;
  const float* logits = nullptr;
  int64_t last_yield = now_us();
  *st = GenStats();

  const int64_t t_prompt = now_us();
  for (int i = 0; i < prompt_len; ++i) {
    logits = run.step(prompt[i]);
    if (!logits) {
      ESP_LOGE(TAG, "prompt is longer than the context (%d)", MAX_CTX);
      return false;
    }
    hist[n_hist++] = prompt[i];
    if (gp.echo) emit_token(model, prompt[i], emit, ctx);
    if (now_us() - last_yield > YIELD_MS * 1000) { vTaskDelay(1); last_yield = now_us(); }
  }
  st->prompt_tokens = prompt_len;
  st->prompt_ms = (now_us() - t_prompt) / 1e3;
  ESP_LOGI(TAG, "prompt: %d tokens in %.2f s", prompt_len, st->prompt_ms / 1e3);

  const int64_t t_gen = now_us();
  for (int k = 0; k < max_new && n_hist < MAX_CTX; ++k) {
    const int next = sampler.pick(logits, hist, n_hist);
    if (next == model.cfg.eos) {
      st->hit_eos = true;
      ESP_LOGI(TAG, "<eos>");
      break;
    }
    emit_token(model, next, emit, ctx);
    hist[n_hist++] = next;
#if PER_TOKEN_LOG
    const int64_t ts = now_us();
#endif
    logits = run.step(next);
    if (!logits) break;
    ++st->tokens;
#if PER_TOKEN_LOG
    ESP_LOGI(TAG, "token %d: %.0f ms", k + 1, (now_us() - ts) / 1e3);
#endif
    if (now_us() - last_yield > YIELD_MS * 1000) { vTaskDelay(1); last_yield = now_us(); }
  }
  st->predicted_ms = (now_us() - t_gen) / 1e3;
  if (st->tokens > 0) {
    ESP_LOGI(TAG, "%d tokens in %.2f s: %.0f ms/token (%.2f tokens/s)", st->tokens, st->predicted_ms / 1e3,
             st->predicted_ms / st->tokens, st->tokens / (st->predicted_ms / 1e3));
  }
  return true;
}

// Tokenizes `text` on the device into ids[0..MAX_CTX). Returns the count, or a negative HTTP-style status.
static int tokenize_prompt(const char* text, size_t len, int* ids, std::string* err) {
  const int n = g_model->encode(text, len, ids, MAX_CTX);
  if (n == -2) {
    *err = "this model file has no tokenizer tables: re-export it with tools/export_model.py";
    return -500;
  }
  if (n < 0 || n >= MAX_CTX) {
    *err = "prompt too long: at most " + std::to_string(MAX_CTX - 1) + " tokens";
    return -400;
  }
  if (n == 0) {
    *err = "empty prompt";
    return -400;
  }
  return n;
}

int engine_complete(const std::string& prompt, const GenParams& gp, std::string* out, GenStats* st, std::string* err) {
  if (!g_model->has_vocab()) {
    *err = "this model file has no embedded vocabulary: re-export it with tools/export_model.py";
    return 500;
  }
  if (xSemaphoreTake(g_busy, 0) != pdTRUE) {
    *err = "busy: another request is being processed";
    return 503;
  }
  static int ids[MAX_CTX];
  int rc = 0;
  const int n = tokenize_prompt(prompt.data(), prompt.size(), ids, err);
  if (n < 0) {
    rc = -n;
  } else {
    out->clear();
    if (!generate(ids, n, gp, string_emit, out, st)) {
      *err = "prompt does not fit in the context";
      rc = 400;
    }
  }
  xSemaphoreGive(g_busy);
  return rc;
}

#if CHAT_MODE
// ---------------------------------------------------------------------------------------------------------------
// Serial protocol (one request per line, terminated by '\n'):
//     P [n=<max_new>] [t=<temp>] [k=<top_k>] [r=<repeat_penalty>] [s=<seed>] <id>,<id>,...
//     C [n=..] [t=..] [k=..] [r=..] [s=..] | <text>        text prompt, tokenized on the device ('\\n' = newline)
// Every option is optional. The reply is the generated text, then
//     @@END prompt_tokens=<n> prompt_ms=<ms> tokens=<n> ms_per_token=<ms>
// ---------------------------------------------------------------------------------------------------------------
static bool read_line(char* buf, int cap) {
  int n = 0;
  for (;;) {
    uint8_t c;
    if (uart_read_bytes(CHAT_UART, &c, 1, pdMS_TO_TICKS(1000)) != 1) continue;
    if (c == '\r') continue;
    if (c == '\n') { buf[n] = 0; return n > 0; }
    if (n < cap - 1) buf[n++] = (char)c;
  }
}

// Parses the "key=value" options at the start of `p`; stops at the first token without '='. Returns the new position
// or nullptr on error.
static char* parse_options(char* p, GenParams* gp) {
  char* end = nullptr;
  for (;;) {
    while (*p == ' ') ++p;
    if (!(*p && p[1] == '=')) return p;
    const char key = p[0];
    p += 2;
    if (key == 'n') gp->max_new = (int)strtol(p, &end, 10);
    else if (key == 't') gp->temp = strtof(p, &end);
    else if (key == 'k') gp->top_k = (int)strtol(p, &end, 10);
    else if (key == 'r') gp->rep = strtof(p, &end);
    else if (key == 's') gp->seed = (uint32_t)strtoul(p, &end, 10);
    else return nullptr;
    if (end == p) return nullptr;
    p = end;
  }
}

static void unescape(const char* s, std::string* out) {
  for (; *s; ++s) {
    if (*s == '\\' && s[1]) {
      ++s;
      out->push_back(*s == 'n' ? '\n' : *s == 't' ? '\t' : *s == 'r' ? '\r' : *s);
    } else {
      out->push_back(*s);
    }
  }
}

static void chat_error(const char* msg) {
  printf("@@ERR %s\n", msg);
  fflush(stdout);
}

static void chat_loop() {
  esp_log_level_set(TAG, ESP_LOG_WARN);  // keep INFO logs out of the reply stream
  uart_driver_install(CHAT_UART, 2 * CHAT_LINE_MAX, 0, 0, nullptr, 0);
  static char line[CHAT_LINE_MAX];
  static int ids[MAX_CTX];
  printf("@@READY ctx=%d vocab=%d tokenizer=%d\n", MAX_CTX, g_model->cfg.vocab, g_model->has_tokenizer() ? 1 : 0);
  fflush(stdout);
  for (;;) {
    if (!read_line(line, sizeof(line))) continue;
    const char kind = line[0];
    if ((kind != 'P' && kind != 'C') || line[1] != ' ') { chat_error("bad request"); continue; }
    GenParams gp;
    char* p = parse_options(line + 2, &gp);
    if (!p) { chat_error("bad option"); continue; }

    int n = 0;
    std::string err;
    xSemaphoreTake(g_busy, portMAX_DELAY);
    if (kind == 'C') {
      if (*p != '|') { xSemaphoreGive(g_busy); chat_error("expected '|' before the text"); continue; }
      std::string text;
      unescape(p + 1, &text);
      n = tokenize_prompt(text.data(), text.size(), ids, &err);
    } else {
      char* end = nullptr;
      for (;;) {
        while (*p == ' ' || *p == ',') ++p;
        if (!*p) break;
        const long v = strtol(p, &end, 10);
        if (end == p || v < 0 || n >= MAX_CTX - 1) { n = -400; err = "bad or too many ids"; break; }
        ids[n++] = (int)v;
        p = end;
      }
      if (n == 0) { n = -400; err = "no ids"; }
    }
    if (n < 0) {
      xSemaphoreGive(g_busy);
      chat_error(err.c_str());
      continue;
    }
    if (gp.max_new < 0 || gp.max_new > MAX_CTX - n) gp.max_new = MAX_CTX - n;
    GenStats st;
    generate(ids, n, gp, console_emit, nullptr, &st);
    xSemaphoreGive(g_busy);
    printf("@@END prompt_tokens=%d prompt_ms=%.0f tokens=%d ms_per_token=%.1f\n", st.prompt_tokens, st.prompt_ms,
           st.tokens, st.tokens > 0 ? st.predicted_ms / st.tokens : 0.0);
    fflush(stdout);
  }
}
#endif

extern "C" void app_main(void) {
  log_mem("boot");

  size_t size = 0;
  const uint8_t* blob = map_model(&size);
  if (!blob) return;

  static ethoric::Model model;  // static: keeps it off the main task stack
  if (!model.load(blob, size)) {
    ESP_LOGE(TAG, "invalid or truncated model: is the partition empty? (make flash-model MODEL=ethoric_int8.bin)");
    return;
  }
  ESP_LOGI(TAG, "model: %u KB, d=%d, %d layers, vocab %d, embedded vocabulary: %s",
           (unsigned)(model.total_bytes() / 1024), model.cfg.d, model.cfg.n_layer, model.cfg.vocab,
           model.has_vocab() ? "yes" : "NO (re-export to print text)");

#if VERIFY_CRC
  {
    const int64_t t0 = now_us();
    const bool good = model.verify_crc();
    ESP_LOGI(TAG, "crc32 %s (%.2f s)", good ? "ok" : "BAD", (now_us() - t0) / 1e6);
    vTaskDelay(1);
    if (!good) {
      ESP_LOGE(TAG, "flash contents do not match the exported file: re-flash with `make flash-model`");
      return;
    }
  }
#endif

  static ethoric::Runner* run = new ethoric::Runner(model, MAX_CTX);
  if (!run->ok()) {
    ESP_LOGE(TAG, "not enough memory for a %d-token context: reduce MAX_CTX", MAX_CTX);
    return;
  }
  ESP_LOGI(TAG, "context %d tokens, runtime RAM ~%.2f MiB", run->max_ctx(), run->ram_bytes() / 1048576.0);

#if AUTOTUNE
  bench_kernels(model, "FLASH", false);  // before the copy, to show how much PSRAM helps
#endif
#if USE_PSRAM_COPY
  relocate_weights(model);
#endif
  log_mem("model ready");
  vTaskDelay(1);

#if AUTOTUNE
  if (FORCE_KERNEL) {
    ethoric::set_kernel(FORCE_KERNEL);
  } else {
    bench_kernels(model, "the final weight location", true);
  }
#else
  if (FORCE_KERNEL) ethoric::set_kernel(FORCE_KERNEL);
#endif

  select_arithmetic(model, *run);
  select_cores(*run);

  g_model = &model;
  g_run = run;
  g_busy = xSemaphoreCreateMutex();
#if USE_HTTP_SERVER
  net_start(MAX_CTX);
  log_mem("network up");
#endif
#if CHAT_MODE
  chat_loop();
#else
  {
    GenParams gp;
    gp.echo = true;
    GenStats st;
    generate(PROMPT, kPromptLen, gp, console_emit, nullptr, &st);
    printf("\nDONE\n");
  }
#if USE_HTTP_SERVER
  for (;;) vTaskDelay(portMAX_DELAY);  // keep serving HTTP requests
#endif
#endif
  log_mem("done");
}
